## CMakeLists.txt
```
cmake_minimum_required(VERSION 3.20.0)
find_package(Zephyr REQUIRED HINTS $ENV{ZEPHYR_BASE})

project(Protocol-Analyzer)

zephyr_include_directories(
    ${ZEPHYR_HAL_ESPRESSIF_MODULE_DIR}/components/hal/include
    ${ZEPHYR_HAL_ESPRESSIF_MODULE_DIR}/components/hal/esp32/include
    ${ZEPHYR_HAL_ESPRESSIF_MODULE_DIR}/components/soc/esp32/include
    ${ZEPHYR_HAL_ESPRESSIF_MODULE_DIR}/components/soc/include
)
# Legacy / Global approach (Not recommended)
include_directories(${CMAKE_CURRENT_SOURCE_DIR}/include)


target_sources(app PRIVATE 
    src/main.c 
    src/hardware_matrix.c 
    src/dma_ring_buffer.c 
    src/parser.c 
    src/decode_spi.c 
    src/decode_i2c.c
    src/decode_can.c 
    src/decode_uart.c  
    src/serial.c
)
```

## prj.conf
```kconfig
# RTOS Core
CONFIG_GPIO=y
CONFIG_SERIAL=y
CONFIG_CONSOLE=y

# Memory & Performance Optimization
CONFIG_HEAP_MEM_POOL_SIZE=16384
CONFIG_MAIN_STACK_SIZE=4096

# USB CDC for PC Streaming
CONFIG_USB_DEVICE_STACK=y
CONFIG_USB_DEVICE_INITIALIZE_AT_BOOT=y
CONFIG_UART_CONSOLE=y
CONFIG_UART_INTERRUPT_DRIVEN=y

# Hardware Peripherals
# Enable ESP32-C6 DMA
CONFIG_DMA=y
```

## app.overlay
```dts
&uart1 {
    status = "okay";
    current-speed = <115200>; // can adjust for higher speeds during capture
    pinctrl-0 = <&uart1_default>;
    pinctrl-names = "default";
};
```

## src/main.c
```c
#include <zephyr/kernel.h>
#include <zephyr/sys/printk.h>
#include "hardware_matrix.h"

// Subsystem Initializers
extern void init_serial_streamer(void);
extern void init_dma_ring_buffer(void);

int main(void) {
    printk("Start 8-Bit Logic Analyzer.\n");
    
    // Initialize Serial stream over the UART bridge
    init_serial_streamer();
    
    // Configure Hardware Matrix, start in IDLE mode
    configure_hardware_matrix(MODE_IDLE);
    printk("[SYSTEM] Matrix configured to safe IDLE state.\n");
    
    // Start DMA Capture engine
    init_dma_ring_buffer();
    printk("[SYSTEM] Boot complete!\n");
    printk("Waiting for PC App commands.\n");
    
    // Go to sleep, let background threads handle the capture & streaming
    k_sleep(K_FOREVER);
    return 0;
}
```

## include/analyzer_config.h
```c
#pragma once

#include <stdint.h>

typedef uint8_t la_sample_t;  

// Define depth of the circular buffer.
// 100,000 samples @ 8-bit = 100 KB of HP (High-Performance) SRAM.
 
#define RING_BUFFER_SAMPLES 100000 

// Expose RAM buffer to the parser thread
extern la_sample_t capture_ram[RING_BUFFER_SAMPLES];
```

## include/hardware_matrix.h
```c
#pragma once

#include <stdint.h>
#include <stdbool.h>
// Allowed states for the hardware matrix; Controlled by the PC App via the USB ISR.
 
// Using 8 Bit Data Bus Width
typedef enum {
    MODE_IDLE,
    MODE_SPI_ONLY,
    MODE_I2C_ONLY,
    MODE_UART_ONLY,
    MODE_CAN_ONLY,
    MODE_SPI_I2C_UART, // 4 + 2 + 2 = 8 pins
    MODE_DUAL_SPI_I2C,
    MODE_SPI_CAN_UART, // 4 + 2 + 2 = 8 pins 
    MODE_I2C_CAN_UART  // 2 + 2 + 2 = 6 pins 
    
} analyzer_mode_t;

// Re-routes the GPIO matrix 
void configure_hardware_matrix(analyzer_mode_t mode);

// Play/Pause Recording
extern volatile bool is_capturing;
```

## include/protocol_masks.h
```c
#pragma once

// Because we dynamically swap CAN, UART, and I2C, the parser assigns a protocol to a slot based on the current active mode.
 

// SPI Lines
// Reserved for: SPI (CS, CLK, MISO, MOSI)
#define MASK_SLOT_1   0x0F  // Binary: 0000 1111
#define SHIFT_SLOT_1  0

// I2C (SCL, SDA) or CAN (TX, RX)
#define MASK_SLOT_2   0x30  // Binary: 0011 0000
#define SHIFT_SLOT_2  4

// UART (TX, RX) or CAN (TX, RX)
#define MASK_SLOT_3   0xC0  // Binary: 1100 0000
#define SHIFT_SLOT_3  6

// Individual Pin Extraction Byte
// Used by State Machines to read shifted bytes.

// For the SPI Decoder (Looking at a 4-bit isolated byte)
#define PIN_SPI_CS    0x01
#define PIN_SPI_CLK   0x02
#define PIN_SPI_MISO  0x04
#define PIN_SPI_MOSI  0x08

// For the I2C, UART, and CAN Decoders 
#define PIN_COM_0     0x01 // SCL / TX / CAN_TX
#define PIN_COM_1     0x02 // SDA / RX / CAN_RX
```

## src/decode_can.c
```c
#include <stdint.h>
#include <stdbool.h>
#include <stdio.h>

// CRC stands for Cyclic Redundancy Check

extern void stream_packet_to_pc(const char* packet);

// 10 MHz Sample Rate / 500k Baud Rate = 20 samples per bit
#define CAN_SAMPLES_PER_BIT 20 

static uint32_t sample_timer = 0;
static bool decoding_active = false;

// Bit Stuffing trackers
static bool last_sampled_bit = true; // CAN idle is Recessive (HIGH/true)
static uint8_t consecutive_identical_bits = 0;

// Frame Data Trackers
static uint32_t current_can_frame_id = 0;
static uint8_t dlc = 0;
static uint8_t data_bytes[8] = {0};
static uint16_t received_crc = 0;
static uint16_t calculated_crc = 0;
static uint8_t bits_decoded = 0;

// The Decoder State Machine
typedef enum {
    STATE_ID,
    STATE_CTRL,  // RTR, IDE, r0, DLC (7 bits total)
    STATE_DATA,
    STATE_CRC
} can_decode_state_t;

static can_decode_state_t frame_state = STATE_ID;

// The CAN 2.0 15-bit CRC Polynomial
#define CAN_CRC_POLY 0x4599

// Helper function to process the shift-register math bit-by-bit
static void update_crc(bool next_bit) {
    bool bit_out = (calculated_crc >> 14) ^ next_bit;
    calculated_crc <<= 1;
    if (bit_out) {
        calculated_crc ^= CAN_CRC_POLY;
    }
    calculated_crc &= 0x7FFF; // Keep it exactly 15 bits
}

// Bit 0 - CAN TX, Bit 1 - CAN RX

void feed_can_decoder(uint8_t current_bits) {
    bool rx_pin = (current_bits & 0x02) != 0; // Bit 1
    
    // etect Start of Frame (SOF) - Dominant (LOW) state
    if (!decoding_active && !rx_pin) {
        decoding_active = true;
        // Wait 1.5 bit widths to get to the center of the first real ID bit
        sample_timer = CAN_SAMPLES_PER_BIT + (CAN_SAMPLES_PER_BIT / 2);
        
        last_sampled_bit = false; 
        consecutive_identical_bits = 1;
        
        // Reset all frame trackers
        current_can_frame_id = 0;
        dlc = 0;
        received_crc = 0;
        calculated_crc = 0;
        bits_decoded = 0;
        frame_state = STATE_ID;
        
        // SOF is included in the CRC calculation
        update_crc(false); 
        return;
    }

    // Sampling 
    if (decoding_active) {
        if (--sample_timer == 0) {
            sample_timer = CAN_SAMPLES_PER_BIT; // Reset for next bit
            
            // Bit stuffing removal logic
            if (consecutive_identical_bits == 5) {
                // Ignore if it is a "Stuff Bit", use it to reset our identical bit counter
                consecutive_identical_bits = 1;
                last_sampled_bit = rx_pin;
                return; // Do not process this bit as data
            }

            // Update identical bit counters
            if (rx_pin == last_sampled_bit) {
                consecutive_identical_bits++;
            } else {
                consecutive_identical_bits = 1;
                last_sampled_bit = rx_pin;
            }

            // Decode Frame 
            // We feed the unstuffed bits into our math engine ONLY before the CRC field
            if (frame_state != STATE_CRC) {
                update_crc(rx_pin);
            }

            switch (frame_state) {
                case STATE_ID:
                    // After the SOF, the next 11 bits are the Packet ID.
                    current_can_frame_id = (current_can_frame_id << 1) | (rx_pin ? 1 : 0);
                    bits_decoded++;
                    
                    if (bits_decoded == 11) {
                        frame_state = STATE_CTRL;
                        bits_decoded = 0;
                    }
                    break;

                case STATE_CTRL:
                    // Next 7 bits: RTR (1), IDE (1), r0 (1), DLC (4)
                    bits_decoded++;
                    if (bits_decoded > 3) {
                        dlc = (dlc << 1) | (rx_pin ? 1 : 0); // Last 4 bits are the DLC
                    }
                    
                    if (bits_decoded == 7) {
                        if (dlc > 8) dlc = 8; // Cap at 8 bytes max
                        frame_state = (dlc > 0) ? STATE_DATA : STATE_CRC;
                        bits_decoded = 0;
                    }
                    break;

                case STATE_DATA:
                    // Read 'dlc' number of bytes (8 bits each)
                    data_bytes[bits_decoded / 8] = (data_bytes[bits_decoded / 8] << 1) | (rx_pin ? 1 : 0);
                    bits_decoded++;
                    
                    if (bits_decoded == (dlc * 8)) {
                        frame_state = STATE_CRC;
                        bits_decoded = 0;
                    }
                    break;

                case STATE_CRC:
                    // Read the 15-bit CRC transmitted by the hardware
                    received_crc = (received_crc << 1) | (rx_pin ? 1 : 0);
                    bits_decoded++;
                    
                    if (bits_decoded == 15) {
                        char buffer[128];
                        bool crc_valid = (received_crc == calculated_crc);
                        
                        snprintf(buffer, sizeof(buffer), 
                                 "[CAN] ID: 0x%03X | DLC: %d | Rx CRC: 0x%04X | Calc CRC: 0x%04X [%s]", 
                                 current_can_frame_id, dlc, received_crc, calculated_crc, 
                                 crc_valid ? "VALID" : "ERROR");
                        
                        stream_packet_to_pc(buffer);
                        decoding_active = false; // Reset for the next packet
                    }
                    break;
            }
        }
    }
}
```

## src/decode_i2c.c
```c
#include <stdint.h>
#include <stdbool.h>
#include <stdio.h>

extern void stream_packet_to_pc(const char* packet);

static uint8_t previous_i2c_bits = 0xFF;

static uint8_t current_byte = 0;
static uint8_t bit_count = 0;
static bool transaction_active = false;

// Bit 0 - SCL, Bit 1 - SDA
 
void feed_i2c_decoder(uint8_t current_bits) {
    
    // Extract individual pin states
    bool scl = (current_bits & 0x01) != 0;
    bool sda = (current_bits & 0x02) != 0;

    // Extract previous pin states
    bool prev_scl = (previous_i2c_bits & 0x01) != 0;
    bool prev_sda = (previous_i2c_bits & 0x02) != 0;

    // Detect START Condition - SDA falls while SCL is HIGH
    if (scl && prev_scl && !sda && prev_sda) {
        transaction_active = true;
        bit_count = 0;
        current_byte = 0;
        stream_packet_to_pc("[I2C] START Condition");
    }

    // Detect STOP Condition - SDA rises while SCL is HIGH
    else if (scl && prev_scl && sda && !prev_sda) {
        transaction_active = false;
        stream_packet_to_pc("[I2C] STOP Condition");
    }

    // Capture Data on SCL Rising Edge
    else if (transaction_active && scl && !prev_scl) {
        
        // The first 8 bits are data/address. The 9th bit is the ACK/NACK.
        if (bit_count < 8) {
            current_byte = (current_byte << 1) | (sda ? 1 : 0);
            bit_count++;
        } 
        else if (bit_count == 8) {
            // 9th clock tick; Read the ACK/NACK status.
            bool is_nack = sda; // HIGH means NACK, LOW means ACK
            
            char buffer[64];
            snprintf(buffer, sizeof(buffer), "[I2C] Byte: 0x%02X [%s]", 
                     current_byte, is_nack ? "NACK" : "ACK");
            stream_packet_to_pc(buffer);
            
            // Reset for the next byte in this transaction
            bit_count = 0; 
            current_byte = 0;
        }
    }

    previous_i2c_bits = current_bits;
}
```

## src/decode_spi.c
```c
#include <stdint.h>
#include <stdbool.h>
#include <stdio.h>

// Bring in USB helper to output decoded data packet
extern void stream_packet_to_pc(const char* packet);

// Previous hardware state
static uint8_t previous_spi_bits = 0xFF; 

// Internal state machine variables
static uint8_t current_mosi_byte = 0;
static uint8_t current_miso_byte = 0;
static uint8_t bit_count = 0;
static bool transaction_active = false;

// Bit 0 - CS, Bit 1 - CLK, Bit 2 - MISO, Bit 3 - MOSI
void feed_spi_decoder(uint8_t current_bits) {
    
    // Extract individual pin states
    bool cs   = (current_bits & 0x01) != 0;
    bool clk  = (current_bits & 0x02) != 0;
    bool miso = (current_bits & 0x04) != 0;
    bool mosi = (current_bits & 0x08) != 0;

    // Extract previous pin states
    bool prev_cs  = (previous_spi_bits & 0x01) != 0;
    bool prev_clk = (previous_spi_bits & 0x02) != 0;

    // Detect CS Falling Edge (Start of transaction)
    if (!cs && prev_cs) {
        transaction_active = true;
        bit_count = 0;
        current_mosi_byte = 0;
        current_miso_byte = 0;
        stream_packet_to_pc("[SPI] CS LOW (Start)");
    }

    // Detect CS Rising Edge (End of transaction)
    if (cs && !prev_cs) {
        transaction_active = false;
        stream_packet_to_pc("[SPI] CS HIGH (End)");
    }

    // Capture Data on CLK Rising Edge (Only if CS is active)
    if (transaction_active && clk && !prev_clk) {
        
        // Shift bits left and insert the new data at bit 0
        current_mosi_byte = (current_mosi_byte << 1) | (mosi ? 1 : 0);
        current_miso_byte = (current_miso_byte << 1) | (miso ? 1 : 0);
        bit_count++;

        // When we have a full 8-bit byte, print it and reset
        if (bit_count == 8) {
            char buffer[64];
            snprintf(buffer, sizeof(buffer), "[SPI] MOSI: 0x%02X | MISO: 0x%02X", 
                     current_mosi_byte, current_miso_byte);
            stream_packet_to_pc(buffer);
            
            bit_count = 0;
            current_mosi_byte = 0;
            current_miso_byte = 0;
        }
    }

    // Save current state for next tick
    previous_spi_bits = current_bits;
}
```

## src/decode_uart.c
```c
#include <stdint.h>
#include <stdbool.h>
#include <stdio.h>

extern void stream_packet_to_pc(const char* packet);

// 10 MHz Sample Rate / 115200 Baud Rate = ~86 samples per bit
#define SAMPLES_PER_BIT 86 

typedef enum {
    UART_IDLE,
    UART_START_BIT,
    UART_DATA_BITS,
    UART_STOP_BIT
} uart_state_t;

static uart_state_t state = UART_IDLE;
static uint8_t previous_uart_bits = 0xFF;

static uint32_t sample_timer = 0;
static uint8_t current_byte = 0;
static uint8_t bit_index = 0;

// Bit 0 - UART TX, Bit 1 - UART RX 
 
void feed_uart_decoder(uint8_t current_bits) {
    
    // Dcode TX line
    bool tx_pin = (current_bits & 0x01) != 0;
    bool prev_tx = (previous_uart_bits & 0x01) != 0;

    switch (state) {
        case UART_IDLE:
            // Detect START BIT (Falling Edge)
            if (!tx_pin && prev_tx) {
                state = UART_START_BIT;
                // Wait 1.5 bit widths to sample the dead-center of the first data bit
                sample_timer = SAMPLES_PER_BIT + (SAMPLES_PER_BIT / 2); 
                current_byte = 0;
                bit_index = 0;
            }
            break;

        case UART_START_BIT:
            if (--sample_timer == 0) {
                state = UART_DATA_BITS;
                sample_timer = SAMPLES_PER_BIT; // Reset timer for 1 full bit width
                
                // Read Bit 0
                current_byte |= (tx_pin ? 1 : 0) << bit_index;
                bit_index++;
            }
            break;

        case UART_DATA_BITS:
            if (--sample_timer == 0) {
                sample_timer = SAMPLES_PER_BIT;
                
                // Read Bits 1 through 7
                current_byte |= (tx_pin ? 1 : 0) << bit_index;
                bit_index++;

                if (bit_index == 8) {
                    state = UART_STOP_BIT;
                }
            }
            break;

        case UART_STOP_BIT:
            if (--sample_timer == 0) {
                // The Stop Bit should be HIGH. If it's LOW, we have a framing error.
                if (tx_pin) {
                    char buffer[64];
                    // UART sends ASCII text a lot, so we print the hex AND the character
                    snprintf(buffer, sizeof(buffer), "[UART] 0x%02X ('%c')", 
                             current_byte, (current_byte >= 32 && current_byte <= 126) ? current_byte : '.');
                    stream_packet_to_pc(buffer);
                } else {
                    stream_packet_to_pc("[UART] ERROR: Framing Error (Missing Stop Bit)");
                }
                state = UART_IDLE; // Ready for the next byte
            }
            break;
    }

    previous_uart_bits = current_bits;
}
```

## src/dma_ring_buffer.c
```c
#include <zephyr/kernel.h>
#include "analyzer_config.h"

// Hardware headers for ESP32 I2S, DMA, and DPORT Clocks
#include <soc/i2s_struct.h>
#include <soc/i2s_reg.h>
#include <rom/lldesc.h>
#include <soc/soc.h>
#include <soc/dport_reg.h>

// RAM block where data is stored
la_sample_t capture_ram[RING_BUFFER_SAMPLES];

// ESP32 DMA descriptor size field is limited to 4095 bytes max per node.
#define DMA_CHUNK_SIZE 4000
#define NUM_DMA_NODES ((RING_BUFFER_SAMPLES * sizeof(la_sample_t)) / DMA_CHUNK_SIZE)

__attribute__((aligned(4))) lldesc_t dma_nodes[NUM_DMA_NODES];

/*
 APB clock is 80MHz on classic ESP32. I2S RX sample clock in camera mode is:
 sample_clk = APB_CLK / clkm_div_num / rx_bck_div_num
 With clkm_div_num=40 and rx_bck_div_num=1 this gives 80MHz/40 = 2MHz.
 Tune clkm_div_num for your target sample rate (higher divider = slower rate).
 clkm_div_a/clkm_div_b are the fractional-divide numerator/denominator; 0/0
 disables the fractional part and uses an integer divide by clkm_div_num.
 */
#define I2S_CLKM_DIV_NUM 40
#define I2S_BCK_DIV_NUM  1

void init_dma_ring_buffer(void) {
    // Build an infinite circular linked list of 4000-byte blocks
    for (int i = 0; i < NUM_DMA_NODES; i++) {
        dma_nodes[i].buf = (uint8_t *)&capture_ram[i * (DMA_CHUNK_SIZE / sizeof(la_sample_t))];
        dma_nodes[i].size = DMA_CHUNK_SIZE;
        dma_nodes[i].length = DMA_CHUNK_SIZE;
        dma_nodes[i].owner = 1; // Owned by DMA hardware
        // Set EOF on every node so in_eof_des_addr updates once per chunk instead of once per full ring lap. This makes get_current_dma_write_index() track live progress instead of jumping once per NUM_DMA_NODES chunks.
        dma_nodes[i].eof = 1;

        // Link to the next node, looping back to 0 at the end
        dma_nodes[i].qe.stqe_next = &dma_nodes[(i + 1) % NUM_DMA_NODES];
    }


    // Enable I2S0 clock using classic DPORT register masks
    SET_PERI_REG_MASK(DPORT_PERIP_CLK_EN_REG, DPORT_I2S0_CLK_EN);
    CLEAR_PERI_REG_MASK(DPORT_PERIP_RST_EN_REG, DPORT_I2S0_RST);

    // Reset I2S0 RX & FIFO
    I2S0.conf.rx_reset = 1;
    I2S0.conf.rx_reset = 0;
    I2S0.conf.rx_fifo_reset = 1;
    I2S0.conf.rx_fifo_reset = 0;
    I2S0.lc_conf.in_rst = 1;
    I2S0.lc_conf.in_rst = 0;

    // Configure Camera Internal Master Mode for Testing
    I2S0.conf.rx_slave_mod = 0;      // Set as MASTER (Internal clock generation)
    I2S0.conf2.camera_en = 1;        // Enable Camera RX mode
    I2S0.sample_rate_conf.rx_bits_mod = 8;
    I2S0.fifo_conf.rx_data_num = 32;
    I2S0.fifo_conf.dscr_en = 1;      // Enable DMA descriptors

    I2S0.clkm_conf.clka_en = 0;              // use APB clock
    I2S0.clkm_conf.clkm_div_num = I2S_CLKM_DIV_NUM;
    I2S0.clkm_conf.clkm_div_a = 0;           
    I2S0.clkm_conf.clkm_div_b = 0;
    I2S0.sample_rate_conf.rx_bck_div_num = I2S_BCK_DIV_NUM;

    // Load custom linked list descriptor address into silicon
    I2S0.in_link.addr = (uint32_t)&dma_nodes[0];
    I2S0.in_link.start = 1;

    // Start RX DMA
    I2S0.conf.rx_start = 1;

    printk("ESP32 I2S Multi-Node DMA Initialized & Active.\n");
    printk("[I2S] sample_clk ~= %u Hz\n", (unsigned)(80000000UL / I2S_CLKM_DIV_NUM / I2S_BCK_DIV_NUM));
}

uint32_t get_current_dma_write_index(void) {

    lldesc_t *eof_desc = (lldesc_t *)I2S0.in_eof_des_addr;

    if (eof_desc == NULL) {
        return 0;
    }

    uint32_t offset_bytes = (uint32_t)eof_desc->buf - (uint32_t)&capture_ram[0];
    return offset_bytes / sizeof(la_sample_t);
}
```

## src/hardware_matrix.c
```c
#include "hardware_matrix.h"

// Include the raw ESP-IDF headers to access the GPIO Matrix and I2S signal definitions.

#include <hal/gpio_hal.h>
#include <soc/gpio_sig_map.h>
#include <esp_rom_gpio.h>

// Fallback block for I2S0 Data Input Signals on classic ESP32
#ifndef I2S0I_DATA_IN0_IDX
#define I2S0I_DATA_IN0_IDX 39
#define I2S0I_DATA_IN1_IDX 40
#define I2S0I_DATA_IN2_IDX 41
#define I2S0I_DATA_IN3_IDX 42
#define I2S0I_DATA_IN4_IDX 43
#define I2S0I_DATA_IN5_IDX 44
#define I2S0I_DATA_IN6_IDX 45
#define I2S0I_DATA_IN7_IDX 46
#endif

#define PIN_SPI_CS   5
#define PIN_SPI_CLK  18
#define PIN_SPI_MISO 19
#define PIN_SPI_MOSI 23
#define PIN_I2C_SCL  33
#define PIN_I2C_SDA  32
#define PIN_UART_TX  4
#define PIN_UART_RX  5
#define PIN_CAN_TX   21
#define PIN_CAN_RX   22

// The global state brain used by the parser thread
volatile analyzer_mode_t current_system_mode = MODE_IDLE;

void configure_hardware_matrix(analyzer_mode_t mode) {
    current_system_mode = mode;

    // Clear any previous I2S routing to prevent signal collisions
    for (int i = 0; i < 8; i++) {
        esp_rom_gpio_connect_in_signal(0x38, I2S0I_DATA_IN0_IDX + i, false);
    }

    switch (mode) {
        // Single Protocol Modes
        case MODE_SPI_ONLY:
            esp_rom_gpio_connect_in_signal(PIN_SPI_CS,   I2S0I_DATA_IN0_IDX, false);
            esp_rom_gpio_connect_in_signal(PIN_SPI_CLK,  I2S0I_DATA_IN1_IDX, false);
            esp_rom_gpio_connect_in_signal(PIN_SPI_MISO, I2S0I_DATA_IN2_IDX, false);
            esp_rom_gpio_connect_in_signal(PIN_SPI_MOSI, I2S0I_DATA_IN3_IDX, false);
            break;

        case MODE_I2C_ONLY:
            esp_rom_gpio_connect_in_signal(PIN_I2C_SCL, I2S0I_DATA_IN0_IDX, false);
            esp_rom_gpio_connect_in_signal(PIN_I2C_SDA, I2S0I_DATA_IN1_IDX, false);
            break;

        case MODE_UART_ONLY:
            esp_rom_gpio_connect_in_signal(PIN_UART_TX, I2S0I_DATA_IN0_IDX, false);
            esp_rom_gpio_connect_in_signal(PIN_UART_RX, I2S0I_DATA_IN1_IDX, false);
            break;

        case MODE_CAN_ONLY:
            esp_rom_gpio_connect_in_signal(PIN_CAN_TX, I2S0I_DATA_IN0_IDX, false);
            esp_rom_gpio_connect_in_signal(PIN_CAN_RX, I2S0I_DATA_IN1_IDX, false);
            break;

        // Multiple Modes (Max 8 Wires)
        case MODE_DUAL_SPI_I2C:
            esp_rom_gpio_connect_in_signal(PIN_SPI_CS,   I2S0I_DATA_IN0_IDX, false);
            esp_rom_gpio_connect_in_signal(PIN_SPI_CLK,  I2S0I_DATA_IN1_IDX, false);
            esp_rom_gpio_connect_in_signal(PIN_SPI_MISO, I2S0I_DATA_IN2_IDX, false);
            esp_rom_gpio_connect_in_signal(PIN_SPI_MOSI, I2S0I_DATA_IN3_IDX, false);
            esp_rom_gpio_connect_in_signal(PIN_I2C_SCL,  I2S0I_DATA_IN4_IDX, false);
            esp_rom_gpio_connect_in_signal(PIN_I2C_SDA,  I2S0I_DATA_IN5_IDX, false);
            break;

        case MODE_SPI_I2C_UART:
            esp_rom_gpio_connect_in_signal(PIN_SPI_CS,   I2S0I_DATA_IN0_IDX, false);
            esp_rom_gpio_connect_in_signal(PIN_SPI_CLK,  I2S0I_DATA_IN1_IDX, false);
            esp_rom_gpio_connect_in_signal(PIN_SPI_MISO, I2S0I_DATA_IN2_IDX, false);
            esp_rom_gpio_connect_in_signal(PIN_SPI_MOSI, I2S0I_DATA_IN3_IDX, false);
            esp_rom_gpio_connect_in_signal(PIN_I2C_SCL,  I2S0I_DATA_IN4_IDX, false);
            esp_rom_gpio_connect_in_signal(PIN_I2C_SDA,  I2S0I_DATA_IN5_IDX, false);
            esp_rom_gpio_connect_in_signal(PIN_UART_TX,  I2S0I_DATA_IN6_IDX, false);
            esp_rom_gpio_connect_in_signal(PIN_UART_RX,  I2S0I_DATA_IN7_IDX, false);
            break;

        case MODE_SPI_CAN_UART:
            esp_rom_gpio_connect_in_signal(PIN_SPI_CS,   I2S0I_DATA_IN0_IDX, false);
            esp_rom_gpio_connect_in_signal(PIN_SPI_CLK,  I2S0I_DATA_IN1_IDX, false);
            esp_rom_gpio_connect_in_signal(PIN_SPI_MISO, I2S0I_DATA_IN2_IDX, false);
            esp_rom_gpio_connect_in_signal(PIN_SPI_MOSI, I2S0I_DATA_IN3_IDX, false);
            esp_rom_gpio_connect_in_signal(PIN_CAN_TX,   I2S0I_DATA_IN4_IDX, false);
            esp_rom_gpio_connect_in_signal(PIN_CAN_RX,   I2S0I_DATA_IN5_IDX, false);
            esp_rom_gpio_connect_in_signal(PIN_UART_TX,  I2S0I_DATA_IN6_IDX, false);
            esp_rom_gpio_connect_in_signal(PIN_UART_RX,  I2S0I_DATA_IN7_IDX, false);
            break;

        case MODE_I2C_CAN_UART:
            esp_rom_gpio_connect_in_signal(PIN_I2C_SCL, I2S0I_DATA_IN0_IDX, false);
            esp_rom_gpio_connect_in_signal(PIN_I2C_SDA, I2S0I_DATA_IN1_IDX, false);
            esp_rom_gpio_connect_in_signal(PIN_CAN_TX,  I2S0I_DATA_IN4_IDX, false);
            esp_rom_gpio_connect_in_signal(PIN_CAN_RX,  I2S0I_DATA_IN5_IDX, false);
            esp_rom_gpio_connect_in_signal(PIN_UART_TX, I2S0I_DATA_IN6_IDX, false);
            esp_rom_gpio_connect_in_signal(PIN_UART_RX, I2S0I_DATA_IN7_IDX, false);
            break;

        case MODE_IDLE:
        default:
            break;
    }
}
```

## src/parser.c
```c
#include <zephyr/kernel.h>
#include <stdbool.h>
#include "analyzer_config.h"
#include "protocol_masks.h"
#include "hardware_matrix.h"

// Ring Buffer
extern la_sample_t capture_ram[RING_BUFFER_SAMPLES];

// Current System Mode, this is basically a State Machine
extern volatile analyzer_mode_t current_system_mode;
extern volatile bool is_capturing;

// Get current index of DMA Write in Circular Buffer
extern uint32_t get_current_dma_write_index(void);

// Decoders for different protocols; Will be called depending on the System State
extern void feed_spi_decoder(uint8_t isolated_bits);
extern void feed_i2c_decoder(uint8_t isolated_bits);
extern void feed_can_decoder(uint8_t isolated_bits);
extern void feed_uart_decoder(uint8_t isolated_bits);

// Create a binary semaphore (max count 1, starts at 0).
// This acts as the event trigger from the USB interrupt.

K_SEM_DEFINE(capture_semaphore, 0, 1);

// Runs in the background, called when trigger fires
void parser_thread(void) {
    uint32_t read_index = 0; 

    while (1) {
        
        // Thread sleeps normally, will only wake up when usb_streamer.c calls k_sem_give().
        k_sem_take(&capture_semaphore, K_FOREVER);

        // Wake up and sync read pointer to the DMA head 
        read_index = get_current_dma_write_index();

        // Running state 
        // Stay in this loop as long as capture ON
        while (is_capturing && current_system_mode != MODE_IDLE) {
            
            uint32_t write_index = get_current_dma_write_index();

            // Process all unread data in the circular buffer
            if (read_index != write_index) {

                // XOR the index by 1 to un-swap the bytes created by the ESP32 I2S DMA
                
                la_sample_t snapshot = capture_ram[read_index ^ 1];
                
                switch (current_system_mode) {
                    // Protocol modes supported
                    case MODE_SPI_ONLY:
                        feed_spi_decoder((snapshot & MASK_SLOT_1) >> SHIFT_SLOT_1);
                        break;
                    case MODE_I2C_ONLY:
                        feed_i2c_decoder((snapshot & MASK_SLOT_1) >> SHIFT_SLOT_1);
                        break;
                    case MODE_UART_ONLY:
                        feed_uart_decoder((snapshot & MASK_SLOT_1) >> SHIFT_SLOT_1);
                        break;
                    case MODE_CAN_ONLY:
                        feed_can_decoder((snapshot & MASK_SLOT_1) >> SHIFT_SLOT_1);
                        break;
                    case MODE_DUAL_SPI_I2C:
                        feed_spi_decoder((snapshot & MASK_SLOT_1) >> SHIFT_SLOT_1);
                        feed_i2c_decoder((snapshot & MASK_SLOT_2) >> SHIFT_SLOT_2);
                        break;
                    case MODE_SPI_I2C_UART:
                        feed_spi_decoder((snapshot & MASK_SLOT_1) >> SHIFT_SLOT_1);
                        feed_i2c_decoder((snapshot & MASK_SLOT_2) >> SHIFT_SLOT_2);
                        feed_uart_decoder((snapshot & MASK_SLOT_3) >> SHIFT_SLOT_3);
                        break;
                    case MODE_SPI_CAN_UART:
                        feed_spi_decoder((snapshot & MASK_SLOT_1) >> SHIFT_SLOT_1);
                        feed_can_decoder((snapshot & MASK_SLOT_2) >> SHIFT_SLOT_2);
                        feed_uart_decoder((snapshot & MASK_SLOT_3) >> SHIFT_SLOT_3);
                        break;
                    case MODE_I2C_CAN_UART:
                        feed_i2c_decoder((snapshot & MASK_SLOT_1) >> SHIFT_SLOT_1);
                        feed_can_decoder((snapshot & MASK_SLOT_2) >> SHIFT_SLOT_2);
                        feed_uart_decoder((snapshot & MASK_SLOT_3) >> SHIFT_SLOT_3);
                        break;
                        
                    default: break;
                }

                read_index = (read_index + 1) % RING_BUFFER_SAMPLES;
            } 
            else {
                // k_yield() only hands off to OTHER THREADS AT THE SAME
                // PRIORITY -- it never lets a lower-priority thread run.
                // With write_index stuck (the still-open DMA bug), this
                // loop was spinning here forever at priority 5, which
                // silently starved every lower-priority thread in the
                // system (e.g. dummy_stream_thread at priority 6) even
                // though it looked like an idle "wait for data" yield.
                // k_msleep() actually blocks this thread and removes it
                // from the ready queue, so lower-priority threads get to
                // run during the wait -- and it's also just more correct
                // for a real "poll every so often" loop than a busy-yield.
                k_msleep(1);
            }
        }
        
        // If the user sends 'H', is_capturing becomes false.
        // The inner loop breaks, and we loop back up to k_sem_take and go back to sleep.
    }
}

// Start parser thread at boot
K_THREAD_DEFINE(parser_id, 4096, parser_thread, NULL, NULL, NULL, 5, 0, 0);
```

## src/serial.c
```c
#include <zephyr/kernel.h>
#include <zephyr/device.h>
#include <zephyr/drivers/uart.h>

#include "hardware_matrix.h"

const struct device *uart_dev = DEVICE_DT_GET(DT_CHOSEN(zephyr_console));

volatile bool is_capturing = false; 

// Bring in the semaphore defined in the parser engine
extern struct k_sem capture_semaphore;

void stream_packet_to_pc(const char* packet) {
   // Capture hardware time
    uint32_t timestamp_us = k_ticks_to_us_floor32(k_cycle_get_32());
    
    //  Prepend the timestamp, add a comma delimiter, then send packet so that timestamps are more accurate and don't suffer from os level serial buffering timestamps lose precision 
    printk("%lu,%s\n", timestamp_us, packet);
}

// Listen to UART commands from the onboard USB-to-UART bridge
void uart_rx_isr(const struct device *dev, void *user_data) {
    uint8_t rx_char;

    if (!uart_irq_update(dev)) {
        return;
    }

    if (uart_irq_rx_ready(dev)) {
        
        while (uart_fifo_read(dev, &rx_char, 1) == 1) {
            
            switch (rx_char) {
                case '0': 
                    printk("Command Rx: Routing Matrix to IDLE\n");
                    configure_hardware_matrix(MODE_IDLE);
                    break;
                
                case 'G': 
                    printk("Command Rx: START CAPTURE\n");
                    is_capturing = true;
                    k_sem_give(&capture_semaphore);
                    break;
                    
                case 'H': 
                    printk("Command Rx: STOP CAPTURE\n");
                    is_capturing = false;
                    break;

                case 'S': 
                    printk("Command Rx: Routing Matrix for SPI\n");
                    configure_hardware_matrix(MODE_SPI_ONLY);
                    break;
                    
                case 'I': 
                    printk("Command Rx: Routing Matrix for I2C\n");
                    configure_hardware_matrix(MODE_I2C_ONLY);
                    break;

                case 'C': 
                    printk("Command Rx: Routing Matrix for CAN\n");
                    configure_hardware_matrix(MODE_CAN_ONLY);
                    break;

                case 'U': 
                    printk("Command Rx: Routing Matrix for UART\n");
                    configure_hardware_matrix(MODE_UART_ONLY);
                    break;
                    
                case '1': 
                    printk("Command Rx: Routing Matrix for Dual SPI + I2C\n");
                    configure_hardware_matrix(MODE_DUAL_SPI_I2C);
                    break;

                case '2': 
                    printk("Command Rx: Routing Matrix for SPI + CAN + UART\n");
                    configure_hardware_matrix(MODE_SPI_CAN_UART);
                    break;

                case '3': 
                    printk("Command Rx: Routing Matrix for I2C + CAN + UART\n");
                    configure_hardware_matrix(MODE_I2C_CAN_UART);
                    break;
                    
                default:
                    break;
            }
        }
    }
}

void init_serial_streamer(void) {
    if (!device_is_ready(uart_dev)) {
        printk("Error: UART device not ready\n");
        return;
    }

    uart_irq_callback_set(uart_dev, uart_rx_isr);
    uart_irq_rx_enable(uart_dev);

    printk("Serial Streamer Initialized and waiting for PC App commands.\n");
}
```

## src/usb.c
```c
#include <zephyr/kernel.h>
#include <zephyr/device.h>
#include <zephyr/drivers/uart.h>
#include <zephyr/usb/usb_device.h>

#include "hardware_matrix.h"

// Get USB device reference from a devicetree compatible
const struct device *usb_dev = DEVICE_DT_GET_ONE(zephyr_cdc_acm_uart);

volatile bool is_capturing = false; 

// Bring in the semaphore defined in the parser engine
extern struct k_sem capture_semaphore;

// Listen to USB commands from PC App on the COM port; Interrupts fired, use FIFO
void usb_rx_isr(const struct device *dev, void *user_data) {
    uint8_t rx_char;

    // Check if the interrupt was valid
    if (!uart_irq_update(dev)) {
        return;
    }

    // Check if the interrupt was triggered by incoming data (RX)
    if (uart_irq_rx_ready(dev)) {
        
        // Read the incoming byte(s) out of the hardware FIFO
        while (uart_fifo_read(dev, &rx_char, 1) == 1) {
            
            // The PC App sends simple ASCII characters to switch modes
            switch (rx_char) {
                case '0': // PC sent "0" -> Switch to IDLE Mode 
                    printk("Command Rx: Routing Matrix to IDLE\n");
                    configure_hardware_matrix(MODE_IDLE);
                    break;
                
                case 'G': // "Go" -> Start streaming data to PC
                    printk("Command Rx: START CAPTURE\n");
                    is_capturing = true;
                    // Wake parser thread 
                    k_sem_give(&capture_semaphore);
                    break;
                    
                case 'H': // "Halt" -> Pause streaming
                    printk("Command Rx: STOP CAPTURE\n");
                    is_capturing = false;
                    break;

                case 'S': // PC sent "S" -> Switch to SPI Mode
                    printk("Command Rx: Routing Matrix for SPI\n");
                    configure_hardware_matrix(MODE_SPI_ONLY);
                    break;
                    
                case 'I': // PC sent "I" -> Switch to I2C Mode
                    printk("Command Rx: Routing Matrix for I2C\n");
                    configure_hardware_matrix(MODE_I2C_ONLY);
                    break;

                case 'C': // PC sent "C" -> Switch to CAN Mode
                    printk("Command Rx: Routing Matrix for CAN\n");
                    configure_hardware_matrix(MODE_CAN_ONLY);
                    break;

                case 'U': // PC sent "U" -> Switch to UART Mode
                    printk("Command Rx: Routing Matrix for UART\n");
                    configure_hardware_matrix(MODE_UART_ONLY);
                    break;
                    
                case '1': // PC sent "1" -> Multiple: SPI + I2C + UART
                    printk("Command Rx: Routing Matrix for SPI + I2C + UART\n");
                    configure_hardware_matrix(MODE_SPI_I2C_UART);
                    break;

                case '2': // PC sent "2" -> Multiple: SPI + CAN + UART
                    printk("Command Rx: Routing Matrix for SPI + CAN + UART\n");
                    configure_hardware_matrix(MODE_SPI_CAN_UART);
                    break;

                case '3': // PC sent "3" -> Multiple: I2C + CAN + UART
                    printk("Command Rx: Routing Matrix for I2C + CAN + UART\n");
                    configure_hardware_matrix(MODE_I2C_CAN_UART);
                    break;
                    
                default:
                    // Ignore unrecognized commands
                    break;
            }
        }
    }
}

// Initialization Function to init USB, called in main
void init_usb_streamer(void) {
    if (!device_is_ready(usb_dev)) {
        printk("Error: USB CDC device not ready\n");
        return;
    }

    // Enable USB
    int ret = usb_enable(NULL);
    if (ret != 0) {
        printk("Error: Failed to enable USB\n");
        return;
    }

    // Register listener function as a callback to listen to USB port
    uart_irq_callback_set(usb_dev, usb_rx_isr);
    
    // Enable RX interrupt 
    uart_irq_rx_enable(usb_dev);

    printk("USB Streamer Initialized and waiting for PC App commands.\n");
}
```
