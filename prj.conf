## CMakeLists.txt
```
cmake_minimum_required(VERSION 3.20.0)
find_package(Zephyr REQUIRED HINTS $ENV{ZEPHYR_BASE})
project(protocol_analyzer)

target_sources(app PRIVATE src/main.c)

# Conditionally compile based on Kconfig
zephyr_sources_ifdef(CONFIG_ENABLE_UART_ANALYZER src/uart.c)
zephyr_sources_ifdef(CONFIG_ENABLE_I2C_ANALYZER src/i2c.c)
```

## Kconfig
```
menu "Protocol Analyzer Modules"

choice ANALYZER_MODE
    prompt "Active Protocol to Analyze"
    default ENABLE_UART_ANALYZER

config ENABLE_UART_ANALYZER
    bool "UART Analyzer"

config ENABLE_I2C_ANALYZER
    bool "I2C Analyzer"

endchoice

endmenu

source "Kconfig.zephyr"
```

## prj.conf
```kconfig
CONFIG_PRINTK=y
CONFIG_ASSERT=y
CONFIG_GPIO=y

CONFIG_SERIAL=y
CONFIG_UART_INTERRUPT_DRIVEN=y

# Enable the Ring Buffer subsystem for thread-to-thread comms
CONFIG_RING_BUFFER=y

# Enable the logging subsystem (better than printk for thread safety)
CONFIG_LOG=y
CONFIG_I2S=y
```

## app.overlay
```dts
&pinctrl {
    uart2_default: uart2_default {
        group1 {
            pinmux = <UART2_RX_GPIO16>;
            bias-pull-up;
        };
    };
};

&uart2 {
    status = "okay";
    current-speed = <115200>; 
    pinctrl-0 = <&uart2_default>;
    pinctrl-names = "default";
};
```

## src/main.c
```c
#include <zephyr/kernel.h>
#include <zephyr/drivers/uart.h>

// Queue to hold the intercepted data
K_MSGQ_DEFINE(uart_msgq, sizeof(char), 256, 4);

// The hardware interrupt - fires every time a byte arrives
static void uart_cb(const struct device *dev, void *user_data)
{
    if (!uart_irq_update(dev)) return;
    if (!uart_irq_rx_ready(dev)) return;

    char c;
    while (uart_fifo_read(dev, &c, 1) == 1) {
        k_msgq_put(&uart_msgq, &c, K_NO_WAIT);
    }
}

int main(void)
{
    // Using UART2 (RX2)
    const struct device *uart_sniffer = DEVICE_DT_GET(DT_NODELABEL(uart2));

    if (!device_is_ready(uart_sniffer)) {
        printk("UART Sniffer not ready!\n");
        return 0;
    }

    // Attach the interrupt
    uart_irq_callback_set(uart_sniffer, uart_cb);
    uart_irq_rx_enable(uart_sniffer);

    printk("Listening for UART traffic on ESP32 RX2 ...\n");

    while (1) {
        char c;
        // Wait for data to hit the queue
        if (k_msgq_get(&uart_msgq, &c, K_FOREVER) == 0) {
            // Print the raw hex and the character
            printk("Caught: 0x%02X (%c)\n", c, c); 
        }
    }
}
```

## include/protocols_supported.h
```c
#ifndef PROTOCOLS_SUPPORTED_H
#define PROTOCOLS_SUPPORTED_H

#include <zephyr/kernel.h>
#include <stdint.h>

typedef enum {
    I2C,
    SPI,
    CAN,
    UART
} protocol;

typedef struct{
    protocol name; // Protocol ID, eg: CAN, UART, etc.
    uint32_t timestamp_us; // Timestamp of payload
    uint8_t payload_length; // length of data packet
    uint8_t payload[8]; // Actual data in the packet, an unsigned int array of length 8, i.e. 8 bit data
    uint8_t *raw_data_ptr;      // Pointer to DMA memory block
} data_packet;

/*
    Zephyr feature: 
    Memory Slab (k_mem_slab) - Dedicated chunk SRAM specifically carved out for DMA to write to.
*/

// Declaring a global message queue to capture and decode data packets
extern struct k_msgq global msgq;

// Declare global memory slab
extern struct k_mem_slab dma_capture_slab;

#endif
```

## src/i2c.c
```c
#include <zephyr/kernel.h>
#include <zephyr/logging/log.h>
#include <zephyr/drivers/gpio.h>

LOG_MODULE_REGISTER(i2c_analyzer, LOG_LEVEL_INF);

// Define ESP32 Pins
#define PROBE_SCL_PIN 22
#define PROBE_SDA_PIN 21

// Updated I2C Packet struct
struct i2c_packet {
    uint8_t raw_byte;
    bool is_start_byte; // True if this is the first byte after a START condition
    bool ack_received;
};

K_MSGQ_DEFINE(i2c_msgq, sizeof(struct i2c_packet), 10, 4);

// ESP32 GPIO controller handle; gpio0 controls pins 0-31
const struct device *gpio_dev = DEVICE_DT_GET(DT_NODELABEL(gpio0));

// Define states for the State Machine to detect edges
enum i2c_state { 
    STATE_IDLE, 
    STATE_READING, 
    STATE_WAITING_ACK 
};

// Thread 1 - The parser thread
void parser_thread(void){
    
    if (!device_is_ready(gpio_dev)) {
        LOG_ERR("GPIO device not ready!");
        return;
    }

    gpio_pin_configure(gpio_dev, PROBE_SCL_PIN, GPIO_INPUT);
    gpio_pin_configure(gpio_dev, PROBE_SDA_PIN, GPIO_INPUT);

    LOG_INF("State Machine Initialized. Waiting for I2C Traffic...");

    // store State Machine previous values
    int prev_scl = 1, curr_scl = 1;
    int prev_sda = 1, curr_sda = 1;
    
    enum i2c_state state = STATE_IDLE;
    uint8_t current_byte = 0;
    int bit_count = 0;
    
    // NEW: Tracker for the address byte
    bool is_first_byte = false;

    while(1){
        // Read physical pins
        curr_scl = gpio_pin_get_raw(gpio_dev, PROBE_SCL_PIN);
        curr_sda = gpio_pin_get_raw(gpio_dev, PROBE_SDA_PIN);

        // Detect START (SDA falls while SCL is High)
        if (prev_scl == 1 && curr_scl == 1 && prev_sda == 1 && curr_sda == 0) {
            state = STATE_READING;
            current_byte = 0;
            bit_count = 0;
            is_first_byte = true; // Flag that a new transaction just started
        }

        // Detect STOP (SDA rises while SCL is High)
        if (prev_scl == 1 && curr_scl == 1 && prev_sda == 0 && curr_sda == 1) {
            state = STATE_IDLE;
        }

        // Sample Data on the SCL Rising Edge
        if (prev_scl == 0 && curr_scl == 1) {
            
            if (state == STATE_READING) {
                // Shift the bit in (so MSB is first)
                current_byte = (current_byte << 1) | curr_sda;
                bit_count++;

                if (bit_count == 8) {
                    state = STATE_WAITING_ACK;
                }
            }
            else if (state == STATE_WAITING_ACK) {
                // The 9th clock pulse determines the ACK / NACK
                bool is_ack = (curr_sda == 0); 

                // I2C full byte; Next pack it
                struct i2c_packet completed_frame = {
                    .raw_byte = current_byte,
                    .is_start_byte = is_first_byte,
                    .ack_received = is_ack
                };

                // Push to the queue
                k_msgq_put(&i2c_msgq, &completed_frame, K_NO_WAIT);

                // Reset to catch the next byte
                is_first_byte = false; // Subsequent bytes are data payloads
                current_byte = 0;
                bit_count = 0;
                state = STATE_READING;
            }
        }

        // Update history for the next iteration
        prev_scl = curr_scl;
        prev_sda = curr_sda;

        // Yield the CPU so the dispatcher thread can wake up and print
        k_yield();
    } 
}

// Thread 2 - The dispatcher thread
void dispatcher_thread(void){
    struct i2c_packet frame;

    while (1){
        // Block until we get a byte from the parser
        k_msgq_get(&i2c_msgq, &frame, K_FOREVER);

        if (frame.is_start_byte) {
            // Extract the 7-bit address and the 1-bit R/W flag
            uint8_t target_address = frame.raw_byte >> 1;
            bool is_read_op = frame.raw_byte & 0x01;

            printk("\n[START] Address: 0x%02X | Op: %s | ACK: %d\n", 
                   target_address, 
                   is_read_op ? "READ " : "WRITE", 
                   frame.ack_received);
        } 
        else {
            // If it's not the start byte, it's just payload data
            printk("        Data:    0x%02X | ACK: %d\n", 
                   frame.raw_byte, 
                   frame.ack_received);
        }
        
        // No sleep delay here because the dispatcher must run as fast as possible to empty the queue. 
        // K_FOREVER automatically yields the CPU when empty.
    }
}

// Start the threads
K_THREAD_DEFINE(parser_id, 1024, parser_thread, NULL, NULL, NULL, 5, 0, 0);
K_THREAD_DEFINE(dispatcher_id, 1024, dispatcher_thread, NULL, NULL, NULL, 7, 0, 0);
```

## src/msg_dispatcher.c
```c
#include <zephyr/kernel.h>
#include <zephyr/logging/log.h>
#include "protocols_supported.h"

// Register a logging module 'dispatcher' on the zephyr logging subsystem;
// Severity level 'INF'means information, so system processes inf, warn and err logs but ignores dbg logs
LOG_MODULE_REGISTER(dispatcher, LOG_LEVEL_INF);

// Function to dispatch data packets from the queue

void dispatcher_thread(void){
    data_packet packet;

    LOG_INF("Dispatcher waiting for data.");

    // Print which protocol data is from
    switch(packet.name){
        case I2C:
        LOG_INF("[%u us] [I2C] Data: 0x%02X", packet.timestamp_us, packet.payload);

        case SPI:
        LOG_INF("[%u us] [SPI] Data: 0x%02X", packet.timestamp_us, packet.payload);

        case CAN:
        LOG_INF("[%u us] [CAN] Data: 0x%02X", packet.timestamp_us, packet.payload);

        case UART:
        LOG_INF("[%u us] [UART] Data: 0x%02X", packet.timestamp_us, packet.payload);

        default:
        LOG_INF("Unknown Packet!");
    }
}

// Define the thread with a 2048-byte stack and priority 3
K_THREAD_DEFINE(dispatcher_id, 2048, dispatcher_thread, NULL, NULL, NULL, 3, 0, 0);

/*
    Parameters for K_THREAD_DEFINE:
    1. name: The variable name for the thread ID.
    2. stack_size: Size of the stack in bytes.
    3. entry: The entry function name.
    4, 5, 6. p1, p2, p3: Up to three argument values passed to the entry function.
    7. prio: Scheduling priority.
    8. options: Thread options (e.g., K_ESSENTIAL).
    9. delay: Time in milliseconds to wait before starting.
*/
```
